## conf/layer.conf
```bitbake
BBPATH .= ":${LAYERDIR}"

BBFILES += "${LAYERDIR}/recipes*/*/*.bb ${LAYERDIR}/recipes*/*/*.bbappend"

BBFILE_COLLECTIONS += "meta-openjdk"
BBFILE_PATTERN_meta-openjdk := "^${LAYERDIR}/"
BBFILE_PRIORITY_meta-openjdk = "10"
LAYERSERIES_COMPAT_meta-openjdk = "wrynose"

LAYERDEPENDS_meta-openjdk += "\
    core \
    openembedded-layer \
"

LICENSE_PATH += "${LAYERDIR}/licenses"

HOSTTOOLS_NONFATAL += "free"

INHERIT += "sanity_meta_openjdk"
```
